#include <SPI.h>
#include <Gamebuino.h>
Gamebuino gb;

void printCagnotte(uint8_t x,uint8_t y);
void printCagnotte();
boolean verrifCanServClient();
boolean canPlay();

const byte rectangleSimple[] PROGMEM = { 9,8,0x00,0x00,0x3C,0x00,0x24,0x00,0x24,0x00,0x24,0x00,0x24,0x00,0x24,0x00,0x3C,0x00 }; 
const byte rondBarre[] PROGMEM = { 9,8,0x00,0x00,0x1C,0x00,0x32,0x00,0x79,0x00,0x5D,0x00,0x4F,0x00,0x26,0x00,0x1C,0x00 }; 
const byte rondCroix[] PROGMEM = { 9,8,0x00,0x00,0x1C,0x00,0x22,0x00,0x49,0x00,0x5D,0x00,0x49,0x00,0x22,0x00,0x1C,0x00 }; 
const byte rondMultip[] PROGMEM = { 9,8,0x00,0x00,0x1C,0x00,0x22,0x00,0x55,0x00,0x49,0x00,0x55,0x00,0x22,0x00,0x1C,0x00 }; 
const byte rondSimple[] PROGMEM = { 9,8,0x00,0x00,0x38,0x00,0x44,0x00,0x82,0x00,0x82,0x00,0x82,0x00,0x44,0x00,0x38,0x00 }; 
const byte trianglePois[] PROGMEM = { 9,8,0x00,0x00,0x00,0x00,0x08,0x00,0x14,0x00,0x2A,0x00,0x55,0x00,0xAA,0x80,0xFF,0x80 }; 
const byte triangleSimple[] PROGMEM = { 9,8,0x00,0x00,0x00,0x00,0x08,0x00,0x14,0x00,0x22,0x00,0x41,0x00,0x80,0x80,0xFF,0x80 }; 
const byte carreCroix[] PROGMEM = { 9,8,0x00,0x00,0xFF,0x00,0x81,0x00,0x99,0x00,0xBD,0x00,0x99,0x00,0x81,0x00,0xFF,0x00 }; 
const byte carreSimple[] PROGMEM = { 9,8,0x00,0x00,0xFF,0x00,0x81,0x00,0x81,0x00,0x81,0x00,0x81,0x00,0x81,0x00,0xFF,0x00 }; 
const byte croixOuverte[] PROGMEM = { 9,8,0x18,0x00,0x18,0x00,0x24,0x00,0xC3,0x00,0xC3,0x00,0x24,0x00,0x18,0x00,0x18,0x00 }; 
const byte croixPleine[] PROGMEM = { 9,8,0x18,0x00,0x18,0x00,0x18,0x00,0xFF,0x00,0xFF,0x00,0x18,0x00,0x18,0x00,0x18,0x00 }; 
const byte rectanglePlein[] PROGMEM = { 9,8,0x00,0x00,0x3C,0x00,0x24,0x00,0x3C,0x00,0x3C,0x00,0x3C,0x00,0x24,0x00,0x3C,0x00 }; 

const byte pluie[] PROGMEM = {32,19,0x3,0xFC,0x0,0x0,0x4,0x1F,0xE0,0x0,0xC,0x7,0x90,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0x0,};
const byte soleil[] PROGMEM = {32,21,0x1,0x8,0x40,0x0,0x1,0x88,0xC0,0x0,0x30,0xC9,0x86,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0x0,};
const byte soleilNuage[] PROGMEM = {40,21,0x0,0x84,0x20,0x0,0x0,0x0,0xC4,0x60,0x0,0x0,0x18,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0x0,};

const byte cornet[] PROGMEM = { 11,6,0xFF,0xE0,0x55,0x40,0x2A,0x80,0x15,0x00,0x0A,0x00,0x04,0x00 }; 
const byte luxeCornet[] PROGMEM = { 11,9,0xFF,0xE0,0x55,0x40,0x2A,0x80,0x15,0x00,0x0A,0x00,0x04,0x00,0x04,0x00,0x04,0x00,0x1F,0x00 }; 
const byte pot[] PROGMEM = { 12,5,0xFF,0xF0,0xE0,0x70,0x70,0xE0,0x3F,0xC0,0x1F,0x80 }; 


const byte bulleVide[] PROGMEM = { 52,27,0x00,0x00,0x00,0x01,0xC0,0x00,0x00,0x00,0x00,0x01,0xFF,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0x00,0x00 }; 


const byte p1C[] PROGMEM = { 26,29,0x00,0x00,0x00,0x00,0x00,0x00,0xC0,0x00,0x02,0x03,0xC0,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0x00,0x00 }; 
const byte p1N[] PROGMEM = { 26,29,0x00,0x00,0x00,0x00,0x00,0x00,0xC0,0x00,0x02,0x03,0xC0,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0x00,0x00 }; 
const byte p1PC[] PROGMEM = { 26,29,0x00,0x00,0x00,0x00,0x00,0x00,0xC0,0x00,0x02,0x03,0xC0,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0x00,0x00 }; 

const byte p2C[] PROGMEM = { 26,29,0x00,0x00,0x00,0x00,0x00,0x1F,0xE0,0x00,0x00,0xFF,0xC0,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0x00,0x00 }; 
const byte p2N[] PROGMEM = { 26,29,0x00,0x00,0x00,0x00,0x00,0x1F,0xE0,0x00,0x00,0xFF,0xC0,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0x00,0x00 }; 
const byte p2PC[] PROGMEM = { 26,29,0x00,0x00,0x00,0x00,0x00,0x1F,0xE0,0x00,0x00,0xFF,0xC0,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0x00,0x00 }; 

const byte p3C[] PROGMEM = { 26,29,0x00,0x00,0x00,0x00,0x00,0xFF,0x80,0x00,0x03,0xFF,0xE0,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0x00,0x00 }; 
const byte p3N[] PROGMEM = { 26,29,0x00,0x00,0x00,0x00,0x00,0xFF,0x80,0x00,0x03,0xFF,0xE0,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0x00,0x00 }; 
const byte p3PC[] PROGMEM = { 26,29,0x00,0x00,0x00,0x00,0x00,0xFF,0x80,0x00,0x03,0xFF,0xE0,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0x00,0x00 }; 

const byte p4PC[] PROGMEM = { 26,29,0x00,0x1F,0xE0,0x00,0x01,0xFF,0xF8,0x00,0x03,0xFF,0xFC,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0xC0,0x00 }; 
const byte p4C[] PROGMEM = { 26,29,0x00,0x1F,0xE0,0x00,0x01,0xFF,0xF8,0x00,0x03,0xFF,0xFC,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0xC0,0x00 }; 
const byte p4N[] PROGMEM = { 26,29,0x00,0x1F,0xE0,0x00,0x01,0xFF,0xF8,0x00,0x03,0xFF,0xFC,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0xC0,0x00 }; 

const byte p5C[] PROGMEM = { 26,29,0x0C,0x00,0x00,0x00,0x03,0xC0,0x00,0x00,0x03,0xFF,0xC4,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0xE0,0x00 }; 
const byte p5N[] PROGMEM = { 26,29,0x0C,0x00,0x00,0x00,0x03,0xC0,0x00,0x00,0x03,0xFF,0xC4,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0xE0,0x00 }; 
const byte p5PC[] PROGMEM = { 26,29,0x0C,0x00,0x00,0x00,0x03,0xC0,0x00,0x00,0x03,0xFF,0xC4,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0xE0,0x00 }; 

const byte p6C[] PROGMEM = { 26,29,0x00,0x00,0x00,0x00,0x00,0x7F,0xE0,0x00,0x03,0xFF,0xF8,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0x00,0x00 }; 
const byte p6N[] PROGMEM = { 26,29,0x00,0x00,0x00,0x00,0x00,0x7F,0xE0,0x00,0x03,0xFF,0xF8,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0x00,0x00 }; 
const byte p6PC[] PROGMEM = { 26,29,0x00,0x00,0x00,0x00,0x00,0x7F,0xE0,0x00,0x03,0xFF,0xF8,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0x00,0x00 }; 

const byte pC[] PROGMEM = { 26,29,0xC2,0x18,0xC0,0x00,0xE7,0x3B,0xCE,0x00,0x65,0xEE,0x7A,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0x00,0x00 }; 
const byte pN[] PROGMEM = { 26,29,0xC2,0x18,0xC0,0x00,0xE7,0x3B,0xCE,0x00,0x65,0xEE,0x7A,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0x00,0x00 }; 
const byte pPC[] PROGMEM = { 26,29,0xC2,0x18,0xC0,0x00,0xE7,0x3B,0xCE,0x00,0x65,0xEE,0x7A,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0x00,0x00 }; 

const byte p7C[] PROGMEM = { 26,29,0x00,0x00,0x00,0x00,0x00,0x10,0x00,0x00,0x00,0x66,0x00,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0x00,0x00 }; 
const byte p7N[] PROGMEM = { 26,29,0x00,0x00,0x00,0x00,0x00,0x10,0x00,0x00,0x00,0x66,0x00,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0x00,0x00 }; 
const byte p7PC[] PROGMEM = { 26,29,0x00,0x00,0x00,0x00,0x00,0x10,0x00,0x00,0x00,0x66,0x00,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0x00,0x00 }; 

const byte p8C[] PROGMEM = { 26,29,0x00,0x00,0x00,0x00,0x00,0x1F,0x80,0x00,0x00,0x7F,0x80,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0x00,0x00 }; 
const byte p8N[] PROGMEM = { 26,29,0x00,0x00,0x00,0x00,0x00,0x1F,0x80,0x00,0x00,0x7F,0x80,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0x00,0x00 }; 
const byte p8PC[] PROGMEM = { 26,29,0x00,0x00,0x00,0x00,0x00,0x1F,0x80,0x00,0x00,0x7F,0x80,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0x00,0x00 }; 

const byte p9C[] PROGMEM = { 26,29,0x00,0x00,0x00,0x00,0x00,0x00,0x00,0x00,0x00,0x00,0x40,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0x00,0x00 }; 
const byte p9N[] PROGMEM = { 26,29,0x00,0x00,0x00,0x00,0x00,0x00,0x00,0x00,0x00,0x00,0x40,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0x00,0x00 }; 
const byte p9PC[] PROGMEM = { 26,29,0x00,0x00,0x00,0x00,0x00,0x00,0x00,0x00,0x00,0x00,0x40,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0x00,0x00 }; 

const byte p10C[] PROGMEM = { 26,29,0x06,0x00,0x03,0x00,0x07,0x3F,0xC7,0x00,0x05,0xE0,0x7C,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0xC2,0x00 }; 
const byte p10N[] PROGMEM = { 26,29,0x06,0x00,0x03,0x00,0x07,0x3F,0xC7,0x00,0x05,0xE0,0x7C,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0xC2,0x00 }; 
const byte p10PC[] PROGMEM = { 26,29,0x06,0x00,0x03,0x00,0x07,0x3F,0xC7,0x00,0x05,0xE0,0x7C,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0xC2,0x00 }; 


const byte p11C[] PROGMEM = { 26,29,0x00,0x00,0x00,0x00,0x01,0xCF,0xC0,0x00,0x07,0xFF,0xF8,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0xF8,0x00 }; 
const byte p11N[] PROGMEM = { 26,29,0x00,0x00,0x00,0x00,0x01,0xCF,0xC0,0x00,0x07,0xFF,0xF8,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0xF8,0x00 }; 
const byte p11PC[] PROGMEM = { 26,29,0x00,0x00,0x00,0x00,0x01,0xCF,0xC0,0x00,0x07,0xFF,0xF8,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0xF8,0x00 }; 

const byte p12C[] PROGMEM = { 26,29,0x00,0x3F,0x80,0x00,0x01,0xF1,0xE0,0x00,0x03,0x00,0x30,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0x00,0x00 }; 
const byte p12N[] PROGMEM = { 26,29,0x00,0x3F,0x80,0x00,0x01,0xF1,0xE0,0x00,0x03,0x00,0x30,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0x00,0x00 }; 
const byte p12PC[] PROGMEM = { 26,29,0x00,0x3F,0x80,0x00,0x01,0xF1,0xE0,0x00,0x03,0x00,0x30,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0x00,0x00 }; 

const byte p13C[] PROGMEM = { 26,29,0x10,0x10,0x00,0x00,0x10,0x10,0x00,0x00,0x18,0x10,0x00,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0x00,0x00 }; 
const byte p13N[] PROGMEM = { 26,29,0x10,0x10,0x00,0x00,0x10,0x10,0x00,0x00,0x18,0x10,0x00,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0x00,0x00 }; 
const byte p13PC[] PROGMEM = { 26,29,0x10,0x10,0x00,0x00,0x10,0x10,0x00,0x00,0x18,0x10,0x00,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0x00,0x00 }; 

const byte p14C[] PROGMEM = { 26,29,0x00,0x7F,0x80,0x00,0x01,0xFF,0xE0,0x00,0x03,0xFF,0xF8,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0x3F,0x80 }; 
const byte p14N[] PROGMEM = { 26,29,0x00,0x7F,0x80,0x00,0x01,0xFF,0xE0,0x00,0x03,0xFF,0xF8,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0x3F,0x80 }; 
const byte p14PC[] PROGMEM = { 26,29,0x00,0x7F,0x80,0x00,0x01,0xFF,0xE0,0x00,0x03,0xFF,0xF8,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0x3F,0x80 }; 

const byte p15C[] PROGMEM = {32,29,0x0,0x1F,0x80,0x0,0x0,0xE0,0x70,0x0,0x3,0x0,0xC,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0x0,};
const byte p15N[] PROGMEM = {32,29,0x0,0x1F,0x80,0x0,0x0,0xE0,0x70,0x0,0x3,0x0,0xC,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0x0,};
const byte p15PC[] PROGMEM = {32,29,0x0,0x1F,0x80,0x0,0x0,0xE0,0x70,0x0,0x3,0x0,0xC,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0x0,};

const byte p16C[] PROGMEM = {32,29,0x0,0x0,0x0,0x0,0x0,0x0,0x18,0x0,0x0,0x0,0x70,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0x0,};
const byte p16N[] PROGMEM = {32,29,0x0,0x0,0x0,0x0,0x0,0x0,0x18,0x0,0x0,0x0,0x70,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0x0,};
const byte p16PC[] PROGMEM = {32,29,0x0,0x0,0x0,0x0,0x0,0x0,0x18,0x0,0x0,0x0,0x70,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0x0,};

const byte p17C[] PROGMEM = {32,29,0x0,0x1F,0xE0,0x0,0x0,0xF0,0x20,0x0,0x1,0x80,0x60,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0x0,};
const byte p17N[] PROGMEM = {32,29,0x0,0x1F,0xE0,0x0,0x0,0xF0,0x20,0x0,0x1,0x80,0x60,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0x0,};
const byte p17PC[] PROGMEM = {32,29,0x0,0x1F,0xE0,0x0,0x0,0xF0,0x20,0x0,0x1,0x80,0x60,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0x0,};


const byte flecheDroite[] PROGMEM = {8,5,0x10,0x8,0xFC,0x8,0x10,};


extern const byte font3x3[]; //a really tiny font
extern const byte font3x5[]; //a small but efficient font (default)
extern const byte font5x7[]; //a small but efficient font (default)

#define NB_MESSAGE 5
#define X_MESSAGE 43
#define Y_MESSAGE 15
uint8_t currentMessage;
const char* const bonjours[NB_MESSAGE] = {
  "Yooo",
  "Hello",
  "Bonjour",
  "Yop",
  "hi"
};

const char* const aurevoir[NB_MESSAGE] = {
  "Tcho",
  "Merci",
  "   A+",
  "Hummm",
  "Thank"
};

const char* const aurevoirPasContent[NB_MESSAGE] = {
  "Howww",
  "Greee",
  "pfeevv",
  "Roow!",
  "..."
};

const byte TitleScreen[] PROGMEM = {64,36,0x0,0x0,0x0,0x0,0x0,0x0,0x0,0x0,0x0,0x0,0x0,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0x0,};

#define ARRIVE_CLIENT 10
#define CHOIX_CLIENT 11
#define CHOIX_VENDEUR 20
#define DEPART_CLIENT 30
#define DEPART_CLIENT_CALC 31
#define FIN_DEPART_CLIENT 32
#define PREPARE_TEMPS 40
#define MAGASIN 41
#define STATS 70
#define GAME_OVER 90

#define NB_MAX_BOULLE 2

uint8_t choixCornet;
uint8_t choixBoulle[NB_MAX_BOULLE];


int8_t choixCornetVendeur;
int8_t choixBoulleVendeur[NB_MAX_BOULLE];
int8_t currentChoixVendeur;

byte gameState;

#define MALUS_BOULLE 1
#define MALUS_CORNET 1
#define DEPART_CAGNOTE_FACILE 21
#define DEPART_CAGNOTE_NORMAL 15
#define DEPART_CAGNOTE_DIFFICIL 12
int cagnotte;
int8_t clientPayer;

typedef struct {
  uint8_t prix,nbStock,prixAchat;
  const byte * sprite;
}
Gout;

#define NB_GOUT 12
Gout allGout[NB_GOUT] = {
  {1,3,1,carreSimple},
  {1,3,1,rectangleSimple},
  {1,3,1,triangleSimple},
  {1,0,1,rondSimple},
  {2,0,2,rondMultip},
  {1,0,1,croixPleine},
  {2,0,1,rectanglePlein},
  {2,0,1,croixOuverte},
  {2,0,2,rondBarre},
  {2,0,2,trianglePois},
  {2,0,2,carreCroix},
  {1,0,1,rondCroix}
};

/*typedef struct {
  uint8_t lvl,prix,lvlMin;
  const byte * sprite;
}
Pot;*/
#define NB_POT 3
Gout allPots[NB_POT] = {
  {0,9,1,pot},
  {1,0,2,cornet},
  {2,0,2,luxeCornet}
};

uint8_t currentClient;
#define NB_ETAT_CLIENT 3
typedef struct {
  const byte * sprite[NB_ETAT_CLIENT];
}
Client;

#define NB_CLIENT 17
Client clients[NB_CLIENT] = {
  {p1N,p1C,p1PC},
  {p2N,p2C,p2PC},
  {p3N,p3C,p3PC},
  {p4N,p4C,p4PC},
  {p5N,p5C,p5PC},
  {p6N,p6C,p6PC},
  {p7N,p7C,p7PC},
  {p8N,p8C,p8PC},
  {p9N,p9C,p9PC},
  {p10N,p10C,p10PC},
  {p11N,p11C,p11PC},
  {p12N,p12C,p12PC},
  {p13N,p13C,p13PC},
  {p14N,p14C,p14PC},
  {p15N,p15C,p15PC},
  {p16N,p16C,p16PC},
  {p17N,p17C,p17PC}
};


#define NB_MAX_CLIENT 16 
#define NB_MIN_CLIENT 3
#define SEUIL_BEAU_TEMP 10
#define SEUIL_PLUIE 6
uint8_t nbClient;

//TODO 7 pour de vrais
#define NB_MAX_JOUR 7
uint8_t jour;

uint8_t nbClientContent;
uint8_t nbClientPasContent;

void setup()
{
  gb.begin();
  initPrograme();
}

void initPrograme()
{
  goTitleScreen();
}

void goTitleScreen()
{
  gb.titleScreen(TitleScreen);
  initGame();
}

const char strTropFace[] PROGMEM = "Facile";
const char strNormal[] PROGMEM = "Normal";
const char strDiff[] PROGMEM = "Difficile";


const char* const menu[3] PROGMEM = {
  strTropFace,
  strNormal,
  strDiff
};

void initGame()
{
  gb.battery.show = false;
  gameState = PREPARE_TEMPS;
  gb.pickRandomSeed();
  
  // = DEPART_CAGNOTE;
  initClient();
  jour = 0;
  
  nbClientContent = 0;
  nbClientPasContent = 0;
  
  allGout[0].nbStock = 3;
  allGout[1].nbStock = 3;
  allGout[2].nbStock = 3;
  allGout[3].nbStock = 0;
  allGout[4].nbStock = 0;
  allGout[5].nbStock = 0;
  allGout[6].nbStock = 0;
  allGout[7].nbStock = 0;
  allGout[8].nbStock = 0;
  allGout[9].nbStock = 0;
  allGout[10].nbStock = 0;
  allGout[11].nbStock = 0;

  switch(gb.menu(menu, 3)){
    case -1: 
      cagnotte = DEPART_CAGNOTE_FACILE;
      break;
    case 0: 
      cagnotte = DEPART_CAGNOTE_FACILE;
      break;
    case 1: 
      cagnotte = DEPART_CAGNOTE_NORMAL;
      break;
    case 2: 
      cagnotte = DEPART_CAGNOTE_DIFFICIL;
      break;
    default:
      cagnotte = DEPART_CAGNOTE_FACILE;
      break;
  }
}

void initClient()
{
  currentChoixVendeur = -1;
  choixCornetVendeur = -1;
  for(byte i=0;i<NB_MAX_BOULLE;i++){
    choixBoulleVendeur[i] = -1;
  }
  clientPayer = 0;
}

void loop()
{
  if(gb.update()) {
    if(gb.buttons.pressed(BTN_C)){
      goTitleScreen();
    }

    switch(gameState)
    {
      case PREPARE_TEMPS : 
        if(canPlay()){
          jour++;
          updatePrepareTemps();
          gameState = MAGASIN;
          affichageJour();
        }else {
          gameState = GAME_OVER;
        }
      break;
      
      case MAGASIN : 
        updateMagasin();
        drawMagasin();
      break;
      
      case CHOIX_CLIENT :
        loadChoixClient();
        drawArriveClient();
        initClient();
        gameState = ARRIVE_CLIENT;
        printCagnotte();
      break;
      case ARRIVE_CLIENT :
        updateArriveClient();
        drawArriveClient();
        printCagnotte();
      break;
      case CHOIX_VENDEUR :
        if(verrifCanServClient()){
          updateChoixVendeur();
          drawChoixVendeur();
          printCagnotte();
          verrifCanServClient();
        } else {
          gameState = PREPARE_TEMPS;
        }
      break;
      case DEPART_CLIENT_CALC :
        updateDepartClientCalc();
        drawDepartClient();
        gameState = DEPART_CLIENT; 
          
      break;
      case DEPART_CLIENT :
        updateDepartClient();
        drawDepartClient();
        printCagnotte();
      break;
      case FIN_DEPART_CLIENT :
      
        cagnotte += clientPayer;
        if(cagnotte<0)cagnotte=0;
        if(nbClient>0){
          gameState = CHOIX_CLIENT;   
          nbClient--;
        }else {
          affichageFinJour();
          gameState = PREPARE_TEMPS;   
        }
      break;
      
      case STATS :
                   
      break;
      case GAME_OVER :
        updateGameOver();
        drawGameOver();
      break;
      
    } 
  }
}

void printCagnotte(uint8_t x,uint8_t y)
{
    gb.display.cursorX = x;
    gb.display.cursorY = y;
    gb.display.print(cagnotte);
    gb.display.print("\34");
}

void printCagnotte()
{
  printCagnotte(0,0);
}




/***************************************************************
*****************************JOUR
***************************************************************/
void affichageJour()
{
  byte cpt = 0;
  while(true){
    if(gb.update()) {
      cpt++;
      
      gb.display.cursorX = 10;
      gb.display.cursorY = 10;
      gb.display.setFont(font5x7);
      gb.display.print(F("JOUR : "));
      gb.display.print(jour);
      if(cpt ==80){
        break;
      }
      
      if(gb.buttons.pressed(BTN_A)){
        break;
      }
    }
  }
}


void affichageFinJour()
{
  byte cpt = 0;
  while(true){
    if(gb.update()) {
      cpt++;
      
      gb.display.cursorX = 10;
      gb.display.cursorY = 10;
      gb.display.setFont(font5x7);
      gb.display.print(F("SOIR : "));
      gb.display.println(jour);
      gb.display.println(F("Perte de 20%"));
      gb.display.print(F("   du stock"));
      if(cpt == 80){
        break;
      }
      
      if(gb.buttons.pressed(BTN_A)){
        break;
      }
    }
  }
}


/***************************************************************
*****************************Game over
***************************************************************/

void updateGameOver()
{
  if(gb.buttons.pressed(BTN_A)){
    initGame();
  }
}


void drawGameOver()
{
  gb.display.cursorX = 30;
  gb.display.cursorY = 10;
  gb.display.setFont(font3x5);
  gb.display.print(F("Game Over"));
  
  gb.display.setFont(font5x7);
  gb.display.cursorX = 5;
  gb.display.cursorY = 20;
  gb.display.print(F("\02"));
  gb.display.println(nbClientContent);
  gb.display.cursorX = 5;
  gb.display.print(F("\01"));
  gb.display.print(nbClientPasContent);
  
  printCagnotte(20,35);
}


/***************************************************************
*****************************Helper fin de partie
***************************************************************/
boolean canPlay()
{
  return jour<NB_MAX_JOUR &&  (cagnotte>0 || verrifCanServClient());
}

boolean verrifCanServClient()
{
  uint8_t nbGlace = 0;
  uint8_t nbCornet = 0;
  
  for(byte i=0;i<NB_GOUT;i++){
    nbGlace += allGout[i].nbStock;
  }
  
  for(byte i=0;i<NB_POT;i++){
    nbCornet += allPots[i].nbStock;
  }
  
  return (nbCornet>0 && nbGlace>1);
}

/***************************************************************
*****************************PREPARE TEMPS ET MAGASIN
***************************************************************/

int8_t mnuMagSelectionCurrent;
void updatePrepareTemps()
{
  nbClient = random(NB_MIN_CLIENT,NB_MAX_CLIENT);
  mnuMagSelectionCurrent = 0;
  if(jour>1){
    for(byte i=0;i<NB_GOUT;i++){
      allGout[i].nbStock = (allGout[i].nbStock * 0.8);//perte seche de 20%
    }
  }
}

void updateMagasin()
{
  if(gb.buttons.pressed(BTN_UP)){
    mnuMagSelectionCurrent--;
  }else if(gb.buttons.pressed(BTN_DOWN)){
    mnuMagSelectionCurrent++;  
  }else if(gb.buttons.pressed(BTN_LEFT)){
      mnuMagSelectionCurrent -= 5;
  }else if(gb.buttons.pressed(BTN_RIGHT)){
      mnuMagSelectionCurrent += 5;  
  } 
  
  if(mnuMagSelectionCurrent<0){
    mnuMagSelectionCurrent = 15 + mnuMagSelectionCurrent;
  } else if(mnuMagSelectionCurrent>14){
    if(mnuMagSelectionCurrent != 19){
          mnuMagSelectionCurrent = mnuMagSelectionCurrent-15;
    }
  }
  
  if(gb.buttons.pressed(BTN_A)){
    if(mnuMagSelectionCurrent<12){
      if(cagnotte>=allGout[mnuMagSelectionCurrent].prixAchat){
        allGout[mnuMagSelectionCurrent].nbStock += 3;
        if(allGout[mnuMagSelectionCurrent].nbStock>9){
          allGout[mnuMagSelectionCurrent].nbStock = 9;
        }
        
        cagnotte -= allGout[mnuMagSelectionCurrent].prixAchat;
      }
    }else if(mnuMagSelectionCurrent != 19){
      if(cagnotte>=allPots[(mnuMagSelectionCurrent-12)].prixAchat){
        allPots[(mnuMagSelectionCurrent-12)].nbStock += 3;
        if(allPots[(mnuMagSelectionCurrent-12)].nbStock>9){ 
          allPots[(mnuMagSelectionCurrent-12)].nbStock = 9;
        }
        cagnotte -= allPots[(mnuMagSelectionCurrent-12)].prixAchat;
     }
    } else {
       gameState = CHOIX_CLIENT;   
    }
  }
}

void drawMagasin()
{
  byte x = 0;
  int8_t offsetY = 0;
    
  if(nbClient>SEUIL_BEAU_TEMP){
    gb.display.drawBitmap(50,1,soleil);
  }else if(nbClient>SEUIL_PLUIE){
    gb.display.drawBitmap(50,1,soleilNuage);
  } else {
    gb.display.drawBitmap(50,1,pluie);
  }
  
  gb.display.setFont(font3x3);
  
  for(byte i=0;i<NB_GOUT;i++){
    if(i==5){
      x = 16;
      offsetY = 45;
    }
    if(i==10){
      x = 33;
      offsetY = 90;
    }
    byte y = (i*9)- offsetY;
    gb.display.drawBitmap(x,y,allGout[i].sprite);
    
    gb.display.cursorX = x + 10;
    gb.display.cursorY = y+4;
    gb.display.print(allGout[i].nbStock);
    
    if(mnuMagSelectionCurrent == i){
      if(gb.frameCount%10>4){
        
        gb.display.setColor(INVERT);
        gb.display.fillRect(x,y,9,9);
        gb.display.setColor(BLACK);
      }
    }
  }
  
  for(byte i=0;i<NB_POT;i++){
    byte y = 19 + (i*8);
    gb.display.drawBitmap(33,y,allPots[i].sprite);
    
    gb.display.cursorX = 46;
    gb.display.cursorY = y + 2;
    gb.display.print(allPots[i].nbStock);
    
    if(mnuMagSelectionCurrent == (i+12) &&  mnuMagSelectionCurrent < 15){
      byte h = 7;
      if(mnuMagSelectionCurrent == 14){h = 11;}
      if(gb.frameCount%10>4){
        gb.display.setColor(INVERT);
        gb.display.fillRect(33,y-1,12,h);
        gb.display.setColor(BLACK);
      }
     }
  }
  
  gb.display.drawRect(64,41,19,7);
  gb.display.drawBitmap(75,42,flecheDroite);
  if(mnuMagSelectionCurrent == 19 && gb.frameCount%10>4){
    gb.display.setColor(INVERT);
    gb.display.drawRect(64,41,19,7);
    gb.display.setColor(BLACK);
  }
  gb.display.cursorX = 66;
  gb.display.cursorY = 43;
  gb.display.print(F("GO"));
  
  if(mnuMagSelectionCurrent != 19){
    printCagnotte(60,24);
    gb.display.cursorX = 60;
    gb.display.cursorY = 30;
    gb.display.print(F("prix"));
  
    gb.display.cursorX = 54;
    gb.display.cursorY = 36;
    if(mnuMagSelectionCurrent<12){
      gb.display.print(allGout[mnuMagSelectionCurrent].prixAchat);
    }else if(mnuMagSelectionCurrent != 19){
      gb.display.print(allPots[(mnuMagSelectionCurrent-12)].prixAchat);
    } 
    gb.display.print("\34 les 3");
  }
}

/***************************************************************
*****************************DEPART CLIENT
***************************************************************/
boolean cornetIsOk;
byte glaceIsOk;
void updateDepartClientCalc()
{
  cornetIsOk = choixCornetVendeur == choixCornet;
  clientPayer += allPots[choixCornetVendeur].prix;
  if(cornetIsOk == false){
    clientPayer -= MALUS_CORNET;
  }
  glaceIsOk = NB_MAX_BOULLE;
  int8_t index[NB_MAX_BOULLE];  
  for(byte i=0;i<NB_MAX_BOULLE;i++){
    index[i] = -1;
  }
  
  for(byte i=0;i<NB_MAX_BOULLE;i++){
    clientPayer += allGout[choixBoulleVendeur[i]].prix;
    //index[i] = -1;
    for(byte t=0;t<NB_MAX_BOULLE;t++){
      if(index[t] == t){
        continue;
      }
      if(choixBoulleVendeur[i] == choixBoulle[t]){
        index[t] = t;
      }
    }
  }
  
  for(byte i=0;i<NB_MAX_BOULLE;i++){
    if(index[i] == -1){
      glaceIsOk--;
      clientPayer -= MALUS_BOULLE;
    }
  }
  
  if(cornetIsOk && glaceIsOk == NB_MAX_BOULLE){
    nbClientContent++;
  }else {
    nbClientPasContent++;
  }
}

void updateDepartClient()
{
  if(gb.buttons.pressed(BTN_A)){
     gameState = FIN_DEPART_CLIENT;
  }
}

void drawDepartClient()
{
  gb.display.setFont(font3x5);
  if(cornetIsOk && glaceIsOk == NB_MAX_BOULLE){
    gb.display.drawBitmap(4,10,clients[currentClient].sprite[1]);
    gb.display.cursorX = X_MESSAGE;
    gb.display.cursorY = Y_MESSAGE;
    gb.display.print(aurevoir[currentMessage]);
  }else {
    gb.display.drawBitmap(4,10,clients[currentClient].sprite[2]);
    gb.display.cursorX = X_MESSAGE;
    gb.display.cursorY = Y_MESSAGE;
    gb.display.print(aurevoirPasContent[currentMessage]);
  }
  gb.display.drawBitmap(28,10,bulleVide);
  gb.display.cursorX = 39;
  gb.display.cursorY = 27;
  gb.display.print(clientPayer);
  gb.display.print("\34");
}

/*******************************************************
**************************Vendeur 
********************************************************/
int8_t currentChoixInterface = 0;
void updateChoixVendeur()
{

  if(currentChoixVendeur<NB_MAX_BOULLE){
    if(currentChoixVendeur == -1){
      //on est sur le choix du cornet
      if(gb.buttons.pressed(BTN_A)){
        if(allPots[currentChoixInterface].nbStock>0){
          allPots[currentChoixInterface].nbStock--;
          choixCornetVendeur= currentChoixInterface;
          currentChoixInterface = 0;
          currentChoixVendeur++;
        }
      }
    } else {
      //on est sur le choix des boulle
      if(gb.buttons.pressed(BTN_A)){
        if(allGout[currentChoixInterface].nbStock>0){
          allGout[currentChoixInterface].nbStock--;
          choixBoulleVendeur[currentChoixVendeur] = currentChoixInterface;
          currentChoixVendeur++;
        }
      }
    }
  } else {
    //on est bloquer sur la glace il ne reste plus qu'a valider
      if(gb.buttons.pressed(BTN_A)){
        currentChoixVendeur=-1;
        gameState = DEPART_CLIENT_CALC;
      }
  }
  
  if(gb.buttons.pressed(BTN_B)){
    currentChoixVendeur--;
    if(currentChoixVendeur>-1) {
      currentChoixInterface = choixBoulleVendeur[currentChoixVendeur];
      choixBoulleVendeur[currentChoixVendeur] = -1;
    } else {
      currentChoixInterface = choixCornetVendeur;
      choixCornetVendeur = -1;
    }
  }
  //Sécurité currentChoixVendeur
  if(currentChoixVendeur<-1) {currentChoixVendeur = -1;}
  if(currentChoixVendeur>NB_MAX_BOULLE) {currentChoixVendeur = (NB_MAX_BOULLE-1);}
  
  
  if(currentChoixVendeur<0){
    if(gb.buttons.pressed(BTN_LEFT) || gb.buttons.pressed(BTN_UP)){
      currentChoixInterface--;
    }else if(gb.buttons.pressed(BTN_RIGHT) || gb.buttons.pressed(BTN_DOWN)){
      currentChoixInterface++;
    }
    if(currentChoixInterface >=NB_POT){
      currentChoixInterface = 0;
    } else if(currentChoixInterface <0){
      currentChoixInterface = NB_POT;
    }
  }else if(currentChoixVendeur<NB_MAX_BOULLE){
    if(gb.buttons.pressed(BTN_LEFT)){
      currentChoixInterface--;
    }else if(gb.buttons.pressed(BTN_RIGHT)){
      currentChoixInterface++;
    }else if(gb.buttons.pressed(BTN_UP)){
      currentChoixInterface += (NB_GOUT/2);
    }else if(gb.buttons.pressed(BTN_DOWN)){
      currentChoixInterface -= (NB_GOUT/2);
    }
    if(currentChoixInterface >=NB_GOUT){
      currentChoixInterface = currentChoixInterface - NB_GOUT;
    } else if(currentChoixInterface <0){
      currentChoixInterface = NB_GOUT + currentChoixInterface;
    }
  }
}

void drawChoixVendeur()
{
  //gb.display.print(choixCornetVendeur);
  byte y = 28;
  int8_t offsetX = 0;
    
  for(byte i=0;i<NB_GOUT;i++){
    if(i==6){
      y = 38;
      offsetX = 66;
    }
    byte x = (2 + (i*11))-offsetX;
    
    gb.display.drawBitmap(x,y,allGout[i].sprite);
    if(allGout[i].nbStock == 0){
      gb.display.setColor(INVERT);
      gb.display.fillRect(x,y,9,8);
      gb.display.setColor(BLACK);
    }
    if(currentChoixVendeur>=0){
      for(byte f=0;f<NB_MAX_BOULLE;f++){
        if(choixBoulleVendeur[f] == i){
          gb.display.drawRect((x-2),(y-1),12,11);
        }
      }
      if(currentChoixInterface == i && (gb.frameCount%10 > 4)){
        gb.display.drawRect((x-2),(y-1),12,11);
      }
    }
  }
  
  for(byte i=0;i<NB_POT;i++){
    byte y = 2+ (i*11);
    gb.display.drawBitmap(70,y,allPots[i].sprite);
    if(allPots[i].nbStock == 0){
      gb.display.setColor(INVERT);
      gb.display.fillRect(70,y,11,9);
      gb.display.setColor(BLACK);
    }
    if(currentChoixVendeur<0){
      if(currentChoixInterface == i && (gb.frameCount%10 > 4)){
        gb.display.drawRect(68,(y-2),16,12);
      }
    } else{
      if(choixCornetVendeur == i){
          gb.display.drawRect(68,(y-2),16,12);
      }
    }
  }
  
  for(byte f=0;f<NB_MAX_BOULLE;f++){
    if(choixBoulleVendeur[f] >-1){
      gb.display.drawBitmap(24 + (f*5),5,allGout[choixBoulleVendeur[f]].sprite);
    }
  }
  
  if(choixCornetVendeur>-1){
    gb.display.drawBitmap(25,13,allPots[choixCornetVendeur].sprite);
  }
  
  if(currentChoixVendeur == NB_MAX_BOULLE && (gb.frameCount%10 > 4)){
     gb.display.drawRect(22,3,16,22);
  }
}


/*******************************************************
**************************Arriver du client
********************************************************/
void loadChoixClient()
{
  currentClient = random(0,NB_CLIENT);
  choixCornet = random(0,NB_POT);
  for(byte i=0;i<NB_MAX_BOULLE;i++){
    choixBoulle[i] = random(0,NB_GOUT);
  }
  currentMessage = random(0,NB_MESSAGE);
}

void updateArriveClient()
{
    if(gb.buttons.pressed(BTN_A)){
        gameState = CHOIX_VENDEUR;
    }
}

void drawArriveClient()
{
  gb.display.drawBitmap(4,10,clients[currentClient].sprite[0]);
  gb.display.drawBitmap(28,10,bulleVide);
  gb.display.cursorX = X_MESSAGE;
  gb.display.cursorY = Y_MESSAGE;
  gb.display.print(bonjours[currentMessage]);
  gb.display.drawBitmap(37,23, allPots[choixCornet].sprite);
  for(byte i=0;i<NB_MAX_BOULLE;i++){
    gb.display.drawBitmap((57 + (i*11)),21,allGout[choixBoulle[i]].sprite);
  }
}
